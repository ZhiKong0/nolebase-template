#include "stm32f10x.h"
#include "Delay.h"
#include "OLED.h"

// OLED控制引脚定义
#define OLED_SCL PBout(7) // SCL
#define OLED_SDA PBout(8) // SDA
#define OLED_RST PBout(9) // RST

// OLED I2C地址
#define OLED_I2C_ADDR 0x78

// 16x8点阵字体库
const uint8_t OLED_Font8x16[][16] = {
    {0x00,0x00,0x00,0x00,0x00,0x00,0x00,0x00,0x00,0x00,0x00,0x00,0x00,0x00,0x00,0x00}, // 空格
    {0x00,0x00,0x00,0x00,0x00,0x1F,0x1F,0x00,0x00,0x00,0x00,0x00,0x00,0x00,0x00,0x00}, // !
    {0x00,0x00,0x03,0x03,0x03,0x00,0x03,0x03,0x03,0x00,0x03,0x03,0x03,0x00,0x00,0x00}, // "
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    {0x00,0x00,0x00,0x00,0x00,0x00,0x00,0x00,0x00,0x00,0x00,0x00,0x00,0x00,0x00,0x00}, // ~
};

// I2C 开始信号
void I2C_Start(void)
{
	OLED_SDA = 1;
	OLED_SCL = 1;
	Delay_us(5);
	OLED_SDA = 0;
	Delay_us(5);
	OLED_SCL = 0;
}

// I2C 结束信号
void I2C_Stop(void)
{
	OLED_SDA = 0;
	OLED_SCL = 1;
	Delay_us(5);
	OLED_SDA = 1;
	Delay_us(5);
}

// I2C 发送一个字节
void I2C_SendByte(uint8_t Byte)
{
	uint8_t i;
	for(i = 0; i < 8; i++)
	{
		OLED_SDA = Byte & 0x80;
		OLED_SCL = 1;
		Delay_us(5);
		OLED_SCL = 0;
		Byte <<= 1;
	}
	OLED_SDA = 1;
	OLED_SCL = 1;
	Delay_us(5);
	OLED_SCL = 0;
}

// 写入命令
void OLED_WriteCommand(uint8_t Command)
{
	I2C_Start();
	I2C_SendByte(OLED_I2C_ADDR);
	I2C_SendByte(0x00); // 写入命令
	I2C_SendByte(Command);
	I2C_Stop();
}

// 写入数据
void OLED_WriteData(uint8_t Data)
{
	I2C_Start();
	I2C_SendByte(OLED_I2C_ADDR);
	I2C_SendByte(0x40); // 写入数据
	I2C_SendByte(Data);
	I2C_Stop();
}

// OLED 初始化
void OLED_Init(void)
{
	GPIO_InitTypeDef GPIO_InitStructure;
	
	// 开启时钟
	RCC_APB2PeriphClockCmd(RCC_APB2Periph_GPIOB, ENABLE);
	
	// 配置引脚
	GPIO_InitStructure.GPIO_Pin = GPIO_Pin_7 | GPIO_Pin_8 | GPIO_Pin_9;
	GPIO_InitStructure.GPIO_Mode = GPIO_Mode_Out_PP;
	GPIO_InitStructure.GPIO_Speed = GPIO_Speed_50MHz;
	GPIO_Init(GPIOB, &GPIO_InitStructure);
	
	// 复位
	OLED_RST = 0;
	Delay_ms(100);
	OLED_RST = 1;
	
	// 初始化命令
	OLED_WriteCommand(0xAE); // 关闭显示
	OLED_WriteCommand(0xD5); // 设置显示时钟分频
	OLED_WriteCommand(0x80);
	OLED_WriteCommand(0xA8); // 设置多路复用率
	OLED_WriteCommand(0x3F);
	OLED_WriteCommand(0xD3); // 设置显示偏移
	OLED_WriteCommand(0x00);
	OLED_WriteCommand(0x40); // 设置显示开始行
	OLED_WriteCommand(0xA1); // 设置左右反置
	OLED_WriteCommand(0xC8); // 设置上下反置
	OLED_WriteCommand(0xDA); // 设置COM硬件引脚配置
	OLED_WriteCommand(0x12);
	OLED_WriteCommand(0x81); // 设置对比度
	OLED_WriteCommand(0xCF);
	OLED_WriteCommand(0xD9); // 设置预充电周期
	OLED_WriteCommand(0xF1);
	OLED_WriteCommand(0xDB); // 设置VCOMH
	OLED_WriteCommand(0x40);
	OLED_WriteCommand(0xA4); // 开启显示全部点阵
	OLED_WriteCommand(0xA6); // 设置正常显示
	OLED_WriteCommand(0xAF); // 开启显示
	
	// 清屏
	OLED_Clear();
}

// 清屏
void OLED_Clear(void)
{
	uint8_t i, j;
	for(i = 0; i < 8; i++)
	{
		OLED_WriteCommand(0xB0 + i);
		OLED_WriteCommand(0x00);
		OLED_WriteCommand(0x10);
		for(j = 0; j < 128; j++)
		{
			OLED_WriteData(0x00);
		}
	}
}

// 显示一个字符
void OLED_ShowChar(uint8_t x, uint8_t y, uint8_t Char)
{
	uint8_t i, j;
	for(i = 0; i < 16; i++)
	{
		OLED_WriteCommand(0xB0 + y + i / 8);
		OLED_WriteCommand(0x00 + x);
		OLED_WriteCommand(0x10 + x >> 4);
		OLED_WriteData(OLED_Font8x16[Char - ' '][i]);
	}
}

// 显示字符串
void OLED_ShowString(uint8_t x, uint8_t y, char *String, uint8_t Size)
{
	uint8_t i = 0;
	while(String[i] != '\0')
	{
		OLED_ShowChar(x, y, String[i]);
		x += 8;
		if(x > 120)
		{
			x = 0;
			y += 2;
		}
		i++;
	}
}