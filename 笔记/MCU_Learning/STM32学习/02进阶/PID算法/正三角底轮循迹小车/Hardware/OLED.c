#include "stm32f10x.h"
#include "Delay.h"
#include "OLED.h"

// 位带操作（必须加，否则 PBout 报错）
#define BITBAND(addr, bitnum) ((addr & 0xF0000000)+0x2000000+((addr & 0xFFFFF)<<5)+(bitnum<<2)) 
#define MEM_ADDR(addr)  *((volatile unsigned long  *)(addr)) 
#define BIT_ADDR(addr, bitnum)   MEM_ADDR(BITBAND(addr, bitnum)) 

#define GPIOB_ODR_Addr    (GPIOB_BASE+12)
#define PBout(n)   BIT_ADDR(GPIOB_ODR_Addr,n)

// OLED引脚
#define OLED_SCL PBout(7)
#define OLED_SDA PBout(8)
#define OLED_RST PBout(9)

#define OLED_I2C_ADDR 0x78

const uint8_t OLED_Font8x16[][16] = {
    {0x00,0x00,0x00,0x00,0x00,0x00,0x00,0x00,0x00,0x00,0x00,0x00,0x00,0x00,0x00,0x00}, // 空格
    {0x00,0x00,0x00,0x00,0x00,0x1F,0x1F,0x00,0x00,0x00,0x00,0x00,0x00,0x00,0x00,0x00}, // !
    {0x00,0x00,0x03,0x03,0x03,0x00,0x03,0x03,0x03,0x00,0x03,0x03,0x03,0x00,0x00,0x00}, // "
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    {0x00,0x00,0x00,0x00,0x7F,0xFF,0xFF,0x3F,0x1F,0x0F,0x03,0x00,0x00,0x00,0x00,0x00}, // Z
};

void I2C_Start(void)
{
	OLED_SDA = 1;
	OLED_SCL = 1;
	Delay_us(1);
	OLED_SDA = 0;
	Delay_us(1);
	OLED_SCL = 0;
}

void I2C_Stop(void)
{
	OLED_SDA = 0;
	OLED_SCL = 1;
	Delay_us(1);
	OLED_SDA = 1;
	Delay_us(1);
}

void I2C_SendByte(uint8_t Byte)
{
	uint8_t i;
	for(i = 0; i < 8; i++)
	{
		OLED_SDA = (Byte & 0x80) ? 1 : 0;
		OLED_SCL = 1;
		Delay_us(1);
		OLED_SCL = 0;
		Byte <<= 1;
	}
	OLED_SDA = 1;
	OLED_SCL = 1;
	Delay_us(1);
	OLED_SCL = 0;
}

void OLED_WriteCommand(uint8_t Command)
{
	I2C_Start();
	I2C_SendByte(OLED_I2C_ADDR);
	I2C_SendByte(0x00);
	I2C_SendByte(Command);
	I2C_Stop();
}

void OLED_WriteData(uint8_t Data)
{
	I2C_Start();
	I2C_SendByte(OLED_I2C_ADDR);
	I2C_SendByte(0x40);
	I2C_SendByte(Data);
	I2C_Stop();
}

void OLED_SetCursor(uint8_t x, uint8_t y)
{
	OLED_WriteCommand(0xB0 + y);
	OLED_WriteCommand(0x00 + (x & 0x0F));
	OLED_WriteCommand(0x10 + (x >> 4));
}

void OLED_Init(void)
{
	GPIO_InitTypeDef GPIO_InitStructure;
	RCC_APB2PeriphClockCmd(RCC_APB2Periph_GPIOB, ENABLE);

	GPIO_InitStructure.GPIO_Pin = GPIO_Pin_7 | GPIO_Pin_8 | GPIO_Pin_9;
	GPIO_InitStructure.GPIO_Mode = GPIO_Mode_Out_PP;
	GPIO_InitStructure.GPIO_Speed = GPIO_Speed_50MHz;
	GPIO_Init(GPIOB, &GPIO_InitStructure);

	OLED_RST = 0;
	Delay_ms(100);
	OLED_RST = 1;

	OLED_WriteCommand(0xAE);
	OLED_WriteCommand(0xD5);
	OLED_WriteCommand(0x80);
	OLED_WriteCommand(0xA8);
	OLED_WriteCommand(0x3F);
	OLED_WriteCommand(0xD3);
	OLED_WriteCommand(0x00);
	OLED_WriteCommand(0x40);
	OLED_WriteCommand(0xA1);
	OLED_WriteCommand(0xC8);
	OLED_WriteCommand(0xDA);
	OLED_WriteCommand(0x12);
	OLED_WriteCommand(0x81);
	OLED_WriteCommand(0xCF);
	OLED_WriteCommand(0xD9);
	OLED_WriteCommand(0xF1);
	OLED_WriteCommand(0xDB);
	OLED_WriteCommand(0x40);
	OLED_WriteCommand(0xA4);
	OLED_WriteCommand(0xA6);
	OLED_WriteCommand(0xAF);

	OLED_Clear();
}

void OLED_Clear(void)
{
	uint8_t i, j;
	for(i = 0; i < 8; i++)
	{
		OLED_WriteCommand(0xB0 + i);
		OLED_WriteCommand(0x00);
		OLED_WriteCommand(0x10);
		for(j = 0; j < 128; j++)
			OLED_WriteData(0x00);
	}
}

void OLED_ShowChar(uint8_t x, uint8_t y, uint8_t chr)
{
	uint8_t p;
	chr -= ' ';
	OLED_SetCursor(x, y);
	for(p=0; p<8; p++) OLED_WriteData(OLED_Font8x16[chr][p]);
	OLED_SetCursor(x, y+1);
	for(p=8; p<16; p++) OLED_WriteData(OLED_Font8x16[chr][p]);
}

void OLED_ShowString(uint8_t x, uint8_t y, char *str, uint8_t size)
{
	while(*str)
	{
		OLED_ShowChar(x, y, *str);
		x += 8;
		if(x>120) {x=0; y+=2;}
		str++;
	}
}